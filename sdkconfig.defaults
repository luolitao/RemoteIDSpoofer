## sdkconfig.defaults
```kconfig
# sdkconfig.defaults
CONFIG_ESP_WIFI_SSID="ESP_RIDS"
CONFIG_ESP_WIFI_PASSWORD="makkauhijau"
CONFIG_ESP_WIFI_CHANNEL=6
CONFIG_ESP_WIFI_MAX_CONNECTIONS=4

# WiFi 配置
CONFIG_WIFI_ENABLED=y
CONFIG_ESP32_WIFI_STATIC_RX_BUFFER_NUM=10
CONFIG_ESP32_WIFI_DYNAMIC_RX_BUFFER_NUM=32

# HTTP 服务器配置
CONFIG_HTTPD_MAX_REQ_HDR_LEN=1024
CONFIG_HTTPD_MAX_URI_LEN=512

# NVS 配置
CONFIG_NVS_ENCRYPTION=n

# 分区表配置
CONFIG_PARTITION_TABLE_CUSTOM=y
CONFIG_PARTITION_TABLE_CUSTOM_FILENAME="partitions.csv"

CONFIG_ESP_TLS_USING_MBEDTLS=N
CONFIG_MBEDTLS_SSL_PROTO_TLS1_2=y
CONFIG_MBEDTLS_KEY_EXCHANGE_RSA=y
CONFIG_MBEDTLS_SSL_MAX_CONTENT_LEN=8192
CONFIG_HTTPD_MAX_REQ_HDR_LEN=1024
CONFIG_HTTPD_MAX_URI_LEN=512
CONFIG_LWIP_MAX_SOCKETS=10
CONFIG_SPI_FLASH_SIZE=8MB

# Disable mbedtls threading to avoid threading_alt.h error
CONFIG_MBEDTLS_THREADING_C=n
CONFIG_MBEDTLS_THREADING_ALT=n

# Disable unnecessary components to reduce compilation memory usage
CONFIG_ESP_LCD_ENABLE=n
CONFIG_NEWLIB_NANO_FORMAT=n
```
